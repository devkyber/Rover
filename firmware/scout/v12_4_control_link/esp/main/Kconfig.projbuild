## firmware/scout/v12_4_control_link/esp/main/Kconfig.projbuild
```kconfig
menu "Jumping Scout PCB"
choice SCOUT_LINK
    prompt "Jetson link"
    default SCOUT_LINK_WIFI
    config SCOUT_LINK_USB
        bool "Native USB Serial/JTAG"
    config SCOUT_LINK_WIFI
        bool "Wi-Fi station on Rover LAN, TCP control 9000 / IMU 9001"
endchoice
config SCOUT_SHOCK_PROFILE
    bool "ICM 6400Hz / ADXL 3200Hz instead of 400Hz / 800Hz"
    default n
endmenu
```

## firmware/scout/v12_4_control_link/esp/sdkconfig.defaults
```kconfig
CONFIG_IDF_TARGET="esp32s3"
CONFIG_ESPTOOLPY_FLASHSIZE_8MB=y
CONFIG_ESPTOOLPY_FLASHMODE_DIO=y
CONFIG_ESPTOOLPY_FLASHFREQ_40M=y
CONFIG_PARTITION_TABLE_CUSTOM=y
CONFIG_PARTITION_TABLE_CUSTOM_FILENAME="partitions.csv"
CONFIG_ESP_CONSOLE_NONE=y
CONFIG_ESP_CONSOLE_SECONDARY_NONE=y
CONFIG_FREERTOS_HZ=1000
CONFIG_COMPILER_OPTIMIZATION_PERF=y
CONFIG_SCOUT_LINK_USB=y
CONFIG_LOG_DEFAULT_LEVEL_ERROR=y
```
